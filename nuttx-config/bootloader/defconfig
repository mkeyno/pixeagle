## nuttx-config/bootloader/defconfig
```kconfig
# =============================================================================
# Pixeagle Bootloader defconfig
# STM32H743VIT6 @ 480 MHz, 16 MHz HSE, 2 MB Flash
# Bootloader size: 128 KB (0x08000000 → 0x08020000)
# USB CDC-ACM bootloader (enumerates as "PX4 BL Pixeagle")
# =============================================================================

# ----------------------------------------------------------------------------- 
# Architecture & Chip
# -----------------------------------------------------------------------------
CONFIG_ARCH="arm"
CONFIG_ARCH_FAMILY="armv7-m"
CONFIG_ARCH_CHIP_STM32H7=y
CONFIG_ARCH_CHIP="stm32h7"
CONFIG_ARCH_CHIP_STM32H743=y
CONFIG_ARCH_CHIP_STM32H743VI=y

# MPU, Cache, FPU (required for H7)
CONFIG_ARM_MPU=y
CONFIG_ARMV7M_L1_CACHE=y
CONFIG_ARMV7M_DCACHE=y
CONFIG_ARMV7M_ICACHE=y
CONFIG_ARMV7M_FPU=y
CONFIG_ARMV7M_FPU_DOUBLE_PRECISION=y
CONFIG_ARMV7M_STACKCHECK=y
CONFIG_ARMV7M_ITMS=y

# ----------------------------------------------------------------------------- 
# Board selection (points to your nuttx-config folder)
# -----------------------------------------------------------------------------
CONFIG_ARCH_BOARD_CUSTOM=y
CONFIG_ARCH_BOARD_CUSTOM_DIR="../../../../boards/px4/pixeagle/nuttx-config"
CONFIG_ARCH_BOARD_CUSTOM_DIR_RELPATH=y
CONFIG_ARCH_BOARD_PIXEAGLE=y
CONFIG_ARCH_BOARD="pixeagle"

# ----------------------------------------------------------------------------- 
# Clocking (16 MHz HSE → 480 MHz SYSCLK)
# -----------------------------------------------------------------------------
CONFIG_STM32H7_BOARD_USEHSE=y
CONFIG_STM32H7_HSE_FREQUENCY=16000000
CONFIG_STM32H7_SYSCLK_FREQUENCY=480000000
CONFIG_STM32H7_HCLK_FREQUENCY=240000000
CONFIG_BOARD_LOOPSPERMSEC=480000

# ----------------------------------------------------------------------------- 
# Flash configuration (2 MB) - ADDED PROGMEM SUPPORT
# -----------------------------------------------------------------------------
CONFIG_STM32H7_FLASH_2048KB=y
CONFIG_STM32H7_FLASH_PREFETCH=y
CONFIG_STM32H7_FLASH_ART_ENABLE=y
CONFIG_STM32H7_FLASH_WAITSTATES=2

# CRITICAL: Enable flash programming support for bootloader
CONFIG_STM32H7_FLASH_CONFIG_DEFAULT=y
CONFIG_STM32H7_PROGMEM=y
CONFIG_ARCH_HAVE_PROGMEM=y

# ----------------------------------------------------------------------------- 
# Power Management - REQUIRED FOR BACKUP REGISTERS (FIXED RTC CONFIG)
# -----------------------------------------------------------------------------
CONFIG_STM32H7_PWR=y
CONFIG_STM32H7_RTC=n
CONFIG_RTC=n
CONFIG_RTC_HIRES=n
CONFIG_RTC_DATETIME=n

# ----------------------------------------------------------------------------- 
# Bootloader size & entry point
# -----------------------------------------------------------------------------
CONFIG_BOOTLOADER_SIZE=131072
CONFIG_BOARD_LATE_INITIALIZE=y
CONFIG_INIT_ENTRYPOINT="bootloader_main"
CONFIG_INIT_STACKSIZE=4096

# ----------------------------------------------------------------------------- 
# USB OTG FS + CDC-ACM (CORRECTED FOR STM32H7)
# -----------------------------------------------------------------------------
CONFIG_STM32H7_HSI48=y
CONFIG_STM32H7_CRS=y
CONFIG_STM32H7_OTGFS=y
CONFIG_USBDEV=y
CONFIG_USBDEV_BUSPOWERED=y
CONFIG_USBDEV_MAXPOWER=500

CONFIG_CDCACM=y
CONFIG_CDCACM_RXBUFSIZE=600
CONFIG_CDCACM_TXBUFSIZE=12000
CONFIG_CDCACM_VENDORID=0x3185
CONFIG_CDCACM_PRODUCTID=0x0038
CONFIG_CDCACM_VENDORSTR="Pixeagle"
CONFIG_CDCACM_PRODUCTSTR="PX4 BL Pixeagle"
CONFIG_SYSTEM_CDCACM=y

CONFIG_CDCACM_IFLOWCONTROL=y

# ----------------------------------------------------------------------------- 
# Board control (reset, poweroff, etc.)
# -----------------------------------------------------------------------------
CONFIG_BOARDCTL=y
CONFIG_BOARDCTL_RESET=y
CONFIG_BOARDCTL_POWEROFF=y
CONFIG_BOARDCTL_IOCTL=y
CONFIG_LIB_BOARDCTL=y
CONFIG_ARCH_HAVE_POWEROFF=y

# ----------------------------------------------------------------------------- 
# Minimal serial console (UART4 @ 115200, used for debug output)
# -----------------------------------------------------------------------------
CONFIG_STM32H7_UART4=y
CONFIG_UART4_SERIAL_CONSOLE=y
CONFIG_UART4_BAUD=115200
CONFIG_SERIAL_TERMIOS=y

# ----------------------------------------------------------------------------- 
# Keep everything else as small as possible (bootloader must fit in 128 KB)
# -----------------------------------------------------------------------------
CONFIG_DISABLE_OS_API=y
CONFIG_SCHED_HPWORK=n
CONFIG_SCHED_LPWORK=n
CONFIG_SCHED_WORKQUEUE=n
CONFIG_BOOT_BANNER=n
CONFIG_FS_PROCFS=n
CONFIG_MM_SMALL=n
CONFIG_NET=n
CONFIG_NETDEV_PHY_IOCTL=n
CONFIG_DISABLE_ENVIRON=y

CONFIG_SYSTEM_NSH=n
CONFIG_NSH_DISABLE_ECHO=n
CONFIG_NSH_DISABLE_SET=n
CONFIG_NSH_DISABLE_SOURCE=n

# Debug symbols (optional)
CONFIG_DEBUG_FEATURES=y
CONFIG_DEBUG_SYMBOLS=y
CONFIG_DEBUG_FULLOPT=y

# Required for sys_tick_handler() hook
CONFIG_SYSTEMTICK_HOOK=y

# Produce raw .bin for STM32CubeProgrammer
CONFIG_RAW_BINARY=y

# ----------------------------------------------------------------------------- 
# End of file
# -----------------------------------------------------------------------------
```

## nuttx-config/nsh/defconfig
```kconfig
# CONFIG_NSH_DISABLE_ECHO is not set
# CONFIG_NSH_DISABLE_SET is not set
# CONFIG_NSH_DISABLE_SLEEP is not set
# CONFIG_NSH_DISABLE_SOURCE is not set
CONFIG_ARCH="arm"
CONFIG_ARCH_BOARD_CUSTOM=y
CONFIG_ARCH_BOARD_CUSTOM_DIR="../../../../boards/px4/pixeagle/nuttx-config"
CONFIG_ARCH_BOARD_CUSTOM_DIR_RELPATH=y
CONFIG_ARCH_BOARD_CUSTOM_NAME=""
CONFIG_ARCH_BOARD_PIXEAGLE=y
CONFIG_ARCH_CHIP="stm32h7"
CONFIG_ARCH_CHIP_STM32H743VI=y
CONFIG_ARCH_CHIP_STM32H7=y
CONFIG_ARMV7M_DCACHE=y
CONFIG_ARMV7M_ICACHE=y
CONFIG_ARMV7M_STACKCHECK=y
CONFIG_ARM_MPU=y
CONFIG_BOARDCTL=y
CONFIG_BOARDCTL_IOCTL=y
CONFIG_BOARDCTL_POWEROFF=y
CONFIG_BOARDCTL_RESET=y
CONFIG_ARCH_HAVE_POWEROFF=y
CONFIG_ARCH_INTERRUPTSTACK=2048
CONFIG_BOARD_LOOPSPERMSEC=480000
CONFIG_BUILTIN=y

# CRITICAL: Enable pthread support for PX4
CONFIG_PTHREAD_MUTEX_TYPES=y
CONFIG_PTHREAD_MUTEX_ROBUST=y
CONFIG_PTHREAD_MUTEX_UNSAFE=y
CONFIG_PTHREAD_MUTEX_BOTH=y
CONFIG_DISABLE_PTHREAD=n
CONFIG_NPTHREAD_KEYS=4
CONFIG_SEM_PREALLOCHOLDERS=16
CONFIG_SEM_NNESTPRIO=16

# Board control functions
CONFIG_BOARDCTL=y
CONFIG_BOARDCTL_IOCTL=y
CONFIG_BOARDCTL_POWEROFF=y
CONFIG_BOARDCTL_RESET=y
CONFIG_LIB_BOARDCTL=y

# Pipe support for MAVLink
CONFIG_PIPES=y
CONFIG_DEV_PIPE_SIZE=1024
CONFIG_DEV_FIFO_SIZE=1024

# CAN support
CONFIG_CAN=y
CONFIG_CAN_EXTID=y
CONFIG_CAN_LOOPBACK=y
CONFIG_CAN_NPENDINGRTR=16
CONFIG_DRIVERS_CAN=y
CONFIG_NET_CAN=y

CONFIG_DEBUG_FEATURES=y
CONFIG_DEBUG_SYMBOLS=y
CONFIG_DEFAULT_SMALL=y

# Filesystem support
CONFIG_FS_FAT=y
CONFIG_FS_PROCFS=y
CONFIG_FS_ROMFS=y
CONFIG_FS_WRITABLE=y

# I2C support
CONFIG_I2C=y
CONFIG_I2C_RESET=y

# SD card support
CONFIG_MMCSD=y
CONFIG_MMCSD_SPI=y
CONFIG_MM_CIRCBUF=y

# MTD/FRAM support
CONFIG_MTD=y
CONFIG_MTD_CONFIG=y
CONFIG_MTD_RAMTRON=y
CONFIG_RAMTRON_FRAM=y
CONFIG_RAMTRON_EMULATE_SECTOR_SHIFT=5
CONFIG_BCH=y

# Network support
CONFIG_NET=y
CONFIG_NETDEV_PHY_IOCTL=y
CONFIG_NET_SOCKOPTS=y
CONFIG_NET_STATISTICS=y
CONFIG_NET_TCP=y
CONFIG_NET_UDP=y

# NSH configuration
CONFIG_NSH_FILEIOSIZE=1024
CONFIG_NSH_LINELEN=128
CONFIG_NSH_BUILTIN_APPS=y

# PWM support
CONFIG_PWM=y

# Work queues
CONFIG_SCHED_HPWORK=y
CONFIG_SCHED_HPWORKPRIORITY=192
CONFIG_SCHED_LPWORK=y
CONFIG_SCHED_LPWORKPRIORITY=50
CONFIG_SCHED_LPNTHREADS=1

# Scheduling instrumentation for logger
CONFIG_SCHED_INSTRUMENTATION=y
CONFIG_SCHED_INSTRUMENTATION_SWITCH=y

# Serial configuration
CONFIG_SERIAL_NPOLLWAITERS=2
CONFIG_SERIAL_TERMIOS=y

# Signal support
CONFIG_SIG_DEFAULT=y

# SPI support
CONFIG_SPI=y
CONFIG_SPI_EXCHANGE=y

# Stack monitoring
CONFIG_STACK_COLORATION=y

# Build date
CONFIG_START_DAY=25
CONFIG_START_MONTH=9
CONFIG_START_YEAR=2025

# STM32H7 peripherals
CONFIG_STM32H7_ADC1=y
CONFIG_STM32H7_FDCAN1=y
CONFIG_STM32H7_FDCAN2=y
CONFIG_STM32H7_I2C1=y
CONFIG_STM32H7_I2C3=y
CONFIG_STM32H7_I2C4=y
CONFIG_STM32H7_OTGFS=y
CONFIG_STM32H7_SPI1=y
CONFIG_STM32H7_SPI2=y
CONFIG_STM32H7_SPI3=y
CONFIG_STM32H7_SPI4=y
CONFIG_STM32H7_SPI_DMA=y
CONFIG_STM32H7_TIM1=y
CONFIG_STM32H7_TIM2=y
CONFIG_STM32H7_TIM3=y
CONFIG_STM32H7_TIM4=y
CONFIG_STM32H7_TIM5=y
CONFIG_STM32H7_TIM8=y
CONFIG_STM32H7_UART4=y
CONFIG_STM32H7_UART5=y
CONFIG_STM32H7_UART7=y
CONFIG_STM32H7_UART8=y
CONFIG_STM32H7_USART2=y
CONFIG_STM32H7_USART3=y

# NSH system
CONFIG_SYSTEM_NSH=y

# Task configuration
CONFIG_TASK_NAME_SIZE=24
CONFIG_MAX_TASKS=64

# Console
CONFIG_UART4_SERIAL_CONSOLE=y

# USB device
CONFIG_USBDEV=y

# Disable environment variables (PX4 uses parameters)
CONFIG_DISABLE_ENVIRON=y

# Application entry point
CONFIG_INIT_ENTRYPOINT="nsh_main"
CONFIG_USER_ENTRYPOINT="init"
CONFIG_BOARDCTL_APP_SYMTAB=y
```

## source/drivers/OLED_96x16/Kconfig
```kconfig
menuconfig DRIVERS_OLED_OLED_96X16_MODULE
			bool "OLED_96x16 OLED Display Driver Module"
					default n
			---help---
						Enable support for OLED_96x16 OLED display (96x16 monochrome)
						as a runtime-loadable driver module.
						This is separate from the board-integrated debug version
						(CONFIG_DRIVERS_OLED_OLED_96X16) which can be used for early boot debugging.
						This module version can be started/stopped at runtime and
						is useful for displaying status information during normal operation.
						Hardware: I2C-based OLED display (SSD1306 compatible subset)
						I2C Address: 0x3C (default)
						Usage:
						oled_96x16 start -X -b 1      # Start on external I2C bus 1
						oled_96x16 status             # Show status
						oled_96x16 test -t "Hello"    # Display text
						oled_96x16 stop               # Stop driver
```
